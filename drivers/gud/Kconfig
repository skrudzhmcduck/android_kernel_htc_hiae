## drivers/gud/Kconfig
```kconfig
#
# MobiCore configuration
#
config MOBICORE_SUPPORT
	tristate "Linux MobiCore Support"
	---help---
	  Enable Linux Kernel MobiCore Support

config MOBICORE_DEBUG
    bool "MobiCore Module debug mode"
    depends on MOBICORE_SUPPORT
    ---help---
      Enable Debug mode in the MobiCore Driver.
      It enables printing information about MobiCore operations

config MOBICORE_VERBOSE
    bool "MobiCore Module verbose debug mode"
    depends on MOBICORE_DEBUG
    ---help---
      Enable Verbose Debug mode in the MobiCore Driver.
      It enables printing extra information about MobiCore operations
      Beware: this is only useful for debuging deep in the driver because
      it prints too much logs


config MOBICORE_API
    tristate "Linux MobiCore API"
    depends on MOBICORE_SUPPORT
    ---help---
      Enable Linux Kernel MobiCore API

#
# Trustonic drivers configuration
#
config TRUSTONIC_TEE
    tristate "Trustonic TEE Driver"
    depends on ARM || ARM64
    default n
    ---help---
      Enable Trustonic TEE support

config TRUSTONIC_TEE_LPAE
    bool "Trustonic TEE uses LPAE"
    depends on TRUSTONIC_TEE
    default n if ARM64
    default n if ARM
    ---help---
      Enable Trustonic TEE 64-bit physical addresses support

config TRUSTONIC_TEE_DEBUG
    bool "Trustonic TEE driver debug mode"
    depends on TRUSTONIC_TEE
    default n
    ---help---
      Enable the debug mode in the Trustonic TEE Driver.

config TRUSTONIC_TRUSTED_UI
    tristate "Trustonic Trusted UI"
    depends on TRUSTONIC_TEE
    ---help---
      Enable Trustonic Trusted User Interface

config TRUSTONIC_TRUSTED_UI_FB_BLANK
    bool "Trustonic Trusted UI with fb_blank"
    depends on TRUSTONIC_TRUSTED_UI
    ---help---
    Blank the framebuffer before starting a TUI session
```

## drivers/htc_ril/Kconfig
```kconfig
config HTC_RADIO_SMEM
	bool "RADIO SMEM"
	default N
	---help---
	Enable to move necessary non-secure data to shared memory

config HTC_MODEM_NOTIFIER
	bool "MODEM NOTIFIER"
	default N
	---help---
	Enable to notify modem APP is rebooting

config HTC_GARBAGE_FILTER
	tristate "HTC_GARBAGE_FILTER"
	default n
	depends on MSM_SMD
	---help---
	  HTC Garbage Filter of TCP

config HTC_DEBUG_RIL_PCN0005_HTC_DUMP_SMSM_LOG
    tristate "HTC_DEBUG_RIL_PCN0005_HTC_DUMP_SMSM_LOG"
    default y
    depends on MSM_SMD
    ---help---
      Dump SMSM log message

config HTC_DEBUG_RIL_PCN0010_HTC_DUMP_IPCROUTER_LOG
    tristate "HTC_DEBUG_RIL_PCN0010_HTC_DUMP_IPCROUTER_LOG"
    default y
    depends on IPC_ROUTER
    ---help---
      Dump IPC router modem log message
```
